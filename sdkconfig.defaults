## sdkconfig.defaults
```kconfig
# Override some defaults to enable PPP
CONFIG_LWIP_PPP_SUPPORT=y
CONFIG_LWIP_PPP_NOTIFY_PHASE_SUPPORT=y
CONFIG_LWIP_PPP_PAP_SUPPORT=y
CONFIG_LWIP_TCPIP_TASK_STACK_SIZE=4096
CONFIG_LWIP_PPP_ENABLE_IPV6=n
# example configs
CONFIG_EXAMPLE_MODEM_UART_TX_PIN=12
CONFIG_EXAMPLE_MODEM_UART_RX_PIN=13
CONFIG_EXAMPLE_MODEM_DEVICE_BG96=y
CONFIG_EXAMPLE_MODEM_PPP_APN="iot.1nce.net"
CONFIG_EXAMPLE_MQTT_BROKER_URI="mqtt://muon.co"
CONFIG_EXAMPLE_MQTT_TEST_TOPIC="/topic/esp-pppos"
CONFIG_EXAMPLE_MQTT_TEST_DATA="esp32-pppos"
```
